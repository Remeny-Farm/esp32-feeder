## firmware/main/Kconfig.projbuild
```kconfig
menu "Feeder"

    config FEEDER_DEVICE_ID
        string "Device id"
        default "feeder-dev"
        help
            Device id, pattern ^[a-z0-9][a-z0-9-]{2,31}$ (3 to 32 characters).
            It is the MQTT client id, part of every topic (feeder/<id>/...),
            and it must equal the CN of the device certificate in certs/.
            The firmware refuses to start MQTT when it is invalid.

    config FEEDER_WIFI_SSID
        string "Wi-Fi SSID"
        default "myssid"
        help
            Compiled-in Wi-Fi credentials are an interim solution. Wi-Fi
            provisioning (BLE or compiled-in) is an open decision, see
            docs/architecture.md. Do not commit real credentials: keep them in
            a local sdkconfig, which is not part of the repository.

    config FEEDER_WIFI_PASSWORD
        string "Wi-Fi password"
        default "mypassword"
        help
            See the help of the SSID. Empty means an open network (not
            recommended).

    config FEEDER_MQTT_BROKER_URI
        string "MQTT broker URI"
        default "mqtts://broker.example.org:8883"
        help
            TLS only (mqtts://). The broker certificate must be signed by the
            CA in certs/ca.crt and its CN or SAN must match the host name here.

    config FEEDER_HOPPER_COUNT
        int "Number of hoppers"
        range 1 3
        default 3

    config FEEDER_HOPPER_NAME_0
        string "Name of hopper 0"
        default "grain"
        help
            Protocol name of hopper 0. Names must be non-empty and unique.

    config FEEDER_HOPPER_NAME_1
        string "Name of hopper 1"
        default "pellet"

    config FEEDER_HOPPER_NAME_2
        string "Name of hopper 2"
        default "mealworm"

    config FEEDER_TZ
        string "Time zone (POSIX TZ string)"
        default "CET-1CEST,M3.5.0,M10.5.0/3"
        help
            Local time decides quiet hours, the daily budget reset (local
            midnight) and the random schedule window.

    config FEEDER_NTP_SERVER
        string "NTP server"
        default "pool.ntp.org"
        help
            Without a synced clock the device rejects all remote commands and
            runs no random scatter.

    menu "Welfare limits (compiled-in maximums)"

        comment "All values below are PLACEHOLDERS. Set them after a welfare review."

        config FEEDER_MAX_DOSE_G_0
            int "Max dose per scatter, hopper 0 (g)"
            range 1 1000
            default 10
            help
                PLACEHOLDER: set after welfare review. No command can exceed it.

        config FEEDER_MAX_DOSE_G_1
            int "Max dose per scatter, hopper 1 (g)"
            range 1 1000
            default 10
            help
                PLACEHOLDER: set after welfare review. No command can exceed it.

        config FEEDER_MAX_DOSE_G_2
            int "Max dose per scatter, hopper 2 (g)"
            range 1 1000
            default 10
            help
                PLACEHOLDER: set after welfare review. No command can exceed it.

        config FEEDER_DAILY_BUDGET_G_0
            int "Daily budget, hopper 0 (g)"
            range 1 10000
            default 30
            help
                PLACEHOLDER: set after welfare review. Counts actual grams per local day.

        config FEEDER_DAILY_BUDGET_G_1
            int "Daily budget, hopper 1 (g)"
            range 1 10000
            default 30
            help
                PLACEHOLDER: set after welfare review. Counts actual grams per local day.

        config FEEDER_DAILY_BUDGET_G_2
            int "Daily budget, hopper 2 (g)"
            range 1 10000
            default 30
            help
                PLACEHOLDER: set after welfare review. Counts actual grams per local day.

        config FEEDER_DAILY_TOTAL_G
            int "Daily budget, all hoppers (g)"
            range 1 30000
            default 50
            help
                PLACEHOLDER: set after welfare review. Applies to the sum of all hoppers.

        config FEEDER_MIN_INTERVAL_S
            int "Minimum interval between scatters (s)"
            range 0 86400
            default 1800
            help
                PLACEHOLDER: set after welfare review. Applies to both random and remote scatters.

        config FEEDER_QUIET_START_MIN
            int "Quiet hours start (local minute of day)"
            range 0 1439
            default 1260
            help
                PLACEHOLDER: set after welfare review. 1260 = 21:00. No cue and no scatter
                during quiet hours. The window may cross midnight. If start equals end,
                quiet hours are disabled; that is NOT recommended.

        config FEEDER_QUIET_END_MIN
            int "Quiet hours end (local minute of day)"
            range 0 1439
            default 420
            help
                PLACEHOLDER: set after welfare review. 420 = 07:00. See the start value.

    endmenu

    menu "Random scatter and sequence"

        config FEEDER_RANDOM_DOSE_G_0
            int "Random scatter dose, hopper 0 (g)"
            range 1 1000
            default 5
            help
                PLACEHOLDER: set after welfare review. A random scatter picks one
                non-empty hopper and doses this amount. The gate still checks it.

        config FEEDER_RANDOM_DOSE_G_1
            int "Random scatter dose, hopper 1 (g)"
            range 1 1000
            default 5
            help
                PLACEHOLDER: set after welfare review. See hopper 0.

        config FEEDER_RANDOM_DOSE_G_2
            int "Random scatter dose, hopper 2 (g)"
            range 1 1000
            default 5
            help
                PLACEHOLDER: set after welfare review. See hopper 0.

        config FEEDER_CUE_DELAY_MS
            int "Delay between cue and dose (ms)"
            range 0 60000
            default 3000
            help
                Time the hens get to come after the cue, before the motors start.

        config FEEDER_SPIN_MS
            int "Spinner run time per scatter (ms)"
            range 100 60000
            default 2000

        config FEEDER_DEFAULT_WINDOW_START_MIN
            int "Default random window start (local minute of day)"
            range 0 1439
            default 480
            help
                Used until the first set_schedule command arrives. 480 = 08:00.
                Must differ from the window end.

        config FEEDER_DEFAULT_WINDOW_END_MIN
            int "Default random window end (local minute of day)"
            range 0 1439
            default 1080
            help
                1080 = 18:00. The end minute is exclusive.

        config FEEDER_DEFAULT_SCATTERS_PER_DAY
            int "Default random scatters per day"
            range 0 24
            default 3

    endmenu

endmenu
```
